## boards/st/nucleo_wba62mi/Kconfig.defconfig
```kconfig
# STM32WBA62MI-NUCLEO board configuration

# Copyright (c) 2025 STMicroelectronics
# SPDX-License-Identifier: Apache-2.0

if BOARD_NUCLEO_WBA62MI

config BOARD
	default "nucleo_wba62mi"

if BT

config SPI
	default y

choice BT_HCI_BUS_TYPE
	default BT_STM32WBA
endchoice

endif # BT

endif # BOARD_NUCLEO_WBA62MI
```

## boards/st/nucleo_wba62mi/Kconfig.nucleo_wba62mi
```kconfig
# STM32WBA62MI-NUCLEO board configuration

# Copyright (c) 2025 STMicroelectronics
# SPDX-License-Identifier: Apache-2.0

config BOARD_NUCLEO_WBA62MI
	select SOC_STM32WBA62XX
```

## boards/st/nucleo_wba62mi/board.yml
```yaml
board:
  name: nucleo_wba62mi
  full_name: Nucleo WBA62MI
  vendor: st
  socs:
    - name: stm32wba62xx
```

## boards/st/nucleo_wba62mi/nucleo_wba62mi_defconfig
```kconfig
# SPDX-License-Identifier: Apache-2.0

# Enable MPU
CONFIG_ARM_MPU=y

# Enable HW stack protection
CONFIG_HW_STACK_PROTECTION=y

# Serial Drivers
CONFIG_SERIAL=y
CONFIG_UART_INTERRUPT_DRIVEN=y

# Enable Console
CONFIG_CONSOLE=y
CONFIG_UART_CONSOLE=y

# GPIO Controller
CONFIG_GPIO=y

# Clock Configuration
CONFIG_CLOCK_CONTROL=y

# SysTick based Kernel (use LPTIM1 if CONFIG_SYS_CLOCK_EXISTS=n)
CONFIG_CORTEX_M_SYSTICK=y
CONFIG_SYS_CLOCK_HW_CYCLES_PER_SEC=32000000

# Enable SMPS regulator
CONFIG_POWER_SUPPLY=y
```

## drivers/sensor/kionix/Kconfig
```kconfig
# Copyright (c) 2024 STMicroelectronics
# SPDX-License-Identifier: Apache-2.0

# zephyr-keep-sorted-start
source "drivers/sensor/kionix/kx132/Kconfig"
# zephyr-keep-sorted-stop
```

## drivers/sensor/kionix/kx132/Kconfig
```kconfig
# Kionix KX132-1211 3-axis accelerometer driver

# Copyright (c) 2024 STMicroelectronics
# SPDX-License-Identifier: Apache-2.0

menuconfig KX132
	bool "KX132-1211 I2C accelerometer sensor driver"
	default n
	depends on DT_HAS_KIONIX_KX132_ENABLED
	select I2C
	help
	  Enable driver for Kionix KX132-1211 tri-axis accelerometer.

if KX132

config KX132_TRIGGER
	bool "Enable interrupt/trigger support"
	default n
	depends on GPIO
	depends on $(dt_compat_any_has_prop,$(DT_COMPAT_KIONIX_KX132),irq-gpios)
	help
	  Enable interrupt-driven trigger support using the system work queue.

endif # KX132
```

## dts/bindings/sensor/kionix,kx132-i2c.yaml
```yaml
# Copyright (c) 2024 STMicroelectronics
# SPDX-License-Identifier: Apache-2.0

description: |
  Kionix KX132-1211 tri-axis accelerometer connected via I2C bus.

compatible: "kionix,kx132"

include: [sensor-device.yaml, i2c-device.yaml]

properties:
  irq-gpios:
    type: phandle-array
    description: |
      INT1 interrupt GPIO pin. This pin signals motion wake-up
      and data-ready events.

  sample-rate:
    type: int
    required: true
    enum:
      - 0    # 0.781 Hz
      - 1    # 1.563 Hz
      - 3    # 3.125 Hz
      - 6    # 6.25 Hz
      - 12   # 12.5 Hz
      - 25
      - 50
      - 100
      - 200
      - 400
      - 800
      - 1600
    description: |
      Accelerometer output data rate in Hz. Only the listed values are
      supported by the hardware. The OWUF debounce clock is derived from
      this rate (clamped to 100 Hz max).

  range:
    type: int
    required: true
    enum:
      - 2
      - 4
      - 8
      - 16
    description: |
      Full-scale measurement range in g.

  wakeup-threshold:
    type: int
    default: 450
    description: |
      Wake-up detection threshold in milli-g (1 mg = g/1000 = 9.80665e-3 m/s²).
      The driver converts this value to 11-bit WUFTH counts internally.

  wakeup-debounce:
    type: int
    default: 640
    description: |
      Wake-up debounce window in milliseconds.
      The driver converts this to WUFC counts using the active OWUF and ODR.
```

## soc/st/stm32/stm32wbax/Kconfig.defconfig.stm32wba62xx
```kconfig
# ST Microelectronics STM32WBA62XX MCU

# Copyright (c) 2025 STMicroelectronics
# SPDX-License-Identifier: Apache-2.0

if SOC_STM32WBA62XX

config NUM_IRQS
	default 70

endif # SOC_STM32WBA62XX
```
